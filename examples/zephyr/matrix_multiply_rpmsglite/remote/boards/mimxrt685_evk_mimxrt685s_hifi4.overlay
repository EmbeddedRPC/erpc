/*
 * Copyright 2026 NXP
 *
 * SPDX-License-Identifier: Apache-2.0
 */

#include <zephyr/dt-bindings/ipc_service/static_vrings.h>
#include <zephyr/dt-bindings/memory-attr/memory-attr-arm.h>

/ {
	chosen {
		/*
		 * shared memory reserved for the inter-processor communication
		 */

		zephyr,ipc_shm = &sram_sh_mem;
		zephyr,ipc = &mailbox_b;
	};

	/* Define memory regions for IPC */
	sram_sh_mem: memory@20070000 {
		compatible = "zephyr,memory-region", "mmio-sram";
		reg = <0x20070000 DT_SIZE_K(64)>;
		zephyr,memory-region = "SRAM_SH_MEM";
		zephyr,memory-attr = <DT_MEM_ARM(ATTR_MPU_IO)>;
	};

	mailbox_b: ipm-mbox {
		compatible = "zephyr,mbox-ipm";
		mboxes = <&mbox 0>, <&mbox 1>;
		mbox-names = "tx", "rx";
	};
};
